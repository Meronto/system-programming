.section .isr_vector, "a" // объявили секцию для векторов прерываний
.align 2 // выровняли секцию по 2 байта
.word 0x20020000 // начальный адрес стека
.word Reset_Handler // адрес обработчика сброса

.equ RCC_AHB1ENR, 0x40023830 // дефайним адрес регистра RCC_AHB1ENR  (включение GPIO)
.equ GPIOCEN, 1<<2 // дефайним бит GPIOCEN в регистре RCC_AHB1ENR
.equ GPIOC_MODER, 0x40020800 // дефайним адрес регистра GPIOC_MODER (режимы)
.equ LED_PIN_OUT, 1<<26 // маска для перевода 13 пина в режим вывода
.equ GPIOC_ODR, 0x40020814 // дефайним адрес регистра GPIOC_ODR (данные)
.equ LED_PIN_BIT, 1<<13 // маска для установки/сброса состояния 13 пина

.syntax unified // используем синтаксис unified (стандартный для ARM)
.thumb // используем режим thumb (16-битный код)
.section .text // определяем секцию для кода
.global Reset_Handler // метка для линкера
.thumb_func // указываем, что функция находится в режиме thumb


// Мини введение в команды:
// LDR R0, =КОНСТАНТА - загрузка адреса ячейки памяти
// LDR R1, [R0] - чтение значения из ячейки памяти
// ORR - прменение маски (побитовый сдвиг влево)
// STR R1, [R0] - отправка значения в ячейку памяти обратно
// BIC - сброс бита в регистре
// SUBS - вычитание с переносом
// BNE - переход, если результат вычитания не равен 0
// B - переход
Reset_Handler:
// == 1. Включение тактирования ==
    LDR R0, =RCC_AHB1ENR // загружаем адрес регистра RCC_AHB1ENR в R0 (0x40023830)
    LDR R1, [R0] // загружаем текущее 32-битное значение регистра RCC_AHB1ENR в R1
    ORR R1, R1, #GPIOCEN // применяем побитовое ИЛИ к R1 и GPIOCEN, чтобы установить бит GPIOCEN и не сбросить другие биты
    STR R1, [R0] // сохраняем обновленное значение в регистр RCC_AHB1ENR
// == 2. Настройка порта GPIOC на вывод ==
    LDR R0, =GPIOC_MODER // загружаем адрес регистра GPIOC_MODER в R0 (0x40020800)
    LDR R1, [R0] // загружаем текущее 32-битное значение регистра GPIOC_MODER в R1
    ORR R1, R1, #LED_PIN_OUT // применяем побитовое ИЛИ к R1 и LED_PIN_OUT, чтобы установить бит LED_PIN_OUT и не сбросить другие биты
    STR R1, [R0] // сохраняем обновленное значение в регистр GPIOC_MODER
// == 3. Управление светодиодом (основной цикл) ==
    LDR R0, =GPIOC_ODR // загружаем адрес регистра GPIOC_ODR в R0 (0x40020814)
    LDR R1, [R0] // загружаем текущее 32-битное значение регистра GPIOC_ODR в R1
    BIC R1, R1, #LED_PIN_BIT // сбросаем бит LED_PIN_BIT в ноль чтобы выключить светодиод
    STR R1, [R0] // сохраняем обновленное значение в регистр GPIOC_ODR
main_loop:
// == Гасим светодиод ==
    LDR R0, =GPIOC_ODR // cнова загружаем адрес регистра GPIOC_ODR в R0 (0x40020814) - защита от перезаписи
    LDR R1, [R0] // загружаем текущее 32-битное значение регистра GPIOC_ODR в R1
    ORR R1, R1, #LED_PIN_BIT // устанавливаем бит LED_PIN_BIT в 1 чтобы включить светодиод
    STR R1, [R0] // сохраняем обновленное значение в регистр GPIOC_ODR
// == Делаем задержку (через долбежку в никуда буквально) ==
    LDR R2, =0x00100000 // загружаем в R2 огромное значение
    delay_1:
        SUBS R2, R2, #1 // уменьшаем R2 на 1
        BNE delay_1 // если R2 не равен 0, то переходим обратно к началу цикла
// == Включаем светодиод ==
    LDR R0, =GPIOC_ODR // cнова загружаем адрес регистра GPIOC_ODR в R0 (0x40020814) - защита от перезаписи
    LDR R1, [R0] // загружаем текущее 32-битное значение регистра GPIOC_ODR в R1
    BIC R1, R1, #LED_PIN_BIT // сбросаем бит LED_PIN_BIT в ноль чтобы выключить светодиод
    STR R1, [R0] // сохраняем обновленное значение в регистр GPIOC_ODR
// == Делаем задержку СНОВА ==
    LDR R2, =0x00100000 // загружаем в R2 огромное значение
    delay_2:
        SUBS R2, R2, #1 // уменьшаем R2 на 1
        BNE delay_2 // если R2 не равен 0, то переходим обратно к началу цикла
        B main_loop // переходим обратно к началу циклаss
